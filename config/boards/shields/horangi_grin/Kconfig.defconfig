## config/boards/shields/horangi_grin/Kconfig.defconfig
```kconfig
if SHIELD_HORANGI_GRIN_LEFT

config ZMK_KEYBOARD_NAME
    default "horangi_grin"

config ZMK_SPLIT_ROLE_CENTRAL
    default y

endif

if SHIELD_HORANGI_GRIN_LEFT || SHIELD_HORANGI_GRIN_RIGHT

config ZMK_SPLIT
    default y

endif
```

## config/boards/shields/horangi_grin/Kconfig.shield
```kconfig
config SHIELD_HORANGI_GRIN_LEFT
    def_bool $(shields_list_contains,horangi_grin_left)

config SHIELD_HORANGI_GRIN_RIGHT
    def_bool $(shields_list_contains,horangi_grin_right)
```
